## config/west.yml
```yaml
manifest:
  remotes:
    - name: zmkfirmware
      url-base: https://github.com/zmkfirmware
    - name: urob
      url-base: https://github.com/urob

  projects:
    - name: zmk
      remote: zmkfirmware
      revision: v0.3.0
      import: app/west.yml

    - name: zmk-board-eyelash
      url: https://github.com/a741725193/zmk-board-eyelash
      revision: main

    - name: zmk-helpers
      remote: urob
      revision: main

  self:
    path: config
```
